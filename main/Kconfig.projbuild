## main/Kconfig.projbuild
```kconfig
menu "Solar controller configuration"

    config SC_1WIRE_GPIO
        int "GPIO number for the 1-wire bus"
        range 0 34 if IDF_TARGET_ESP32
        range 0 46 if IDF_TARGET_ESP32S2
        range 0 19 if IDF_TARGET_ESP32C3
        default 4
        help
            GPIO number for the 1-wire bus.

    config SC_SAMPLE_PERIOD
        int "Number of seconds between readings."
        range 1 3600
        default 1
        help
            Number of seconds between readings.

    config SC_PANEL_PUMP_GPIO
        int "PIN used to send PWM signal to the panel pump."
        range 0 34 if IDF_TARGET_ESP32
        range 0 46 if IDF_TARGET_ESP32S2
        range 0 19 if IDF_TARGET_ESP32C3
        default 19
        help
            GPIO number for the panel pump.

    config SC_FLOOR_HEATING_PUMP_GPIO
        int "PIN used to send PWM signal to the floor heating pump."
        range 0 34 if IDF_TARGET_ESP32
        range 0 46 if IDF_TARGET_ESP32S2
        range 0 19 if IDF_TARGET_ESP32C3
        default 21
        help
            GPIO number for the floor heating pump.

    config SC_PUMP_PWM_FREQ
        int "PWM Frequency used to drive both pumps."
        range 1000 10000
        default 1000
        help
            PWM Frequency used to drive both pumps.

    config SC_STACK_SIZE
        int "Stack size for the solar controller."
        range 1024 16384
        default 4096
        help
            Defines stack size. Insufficient stack size can cause crash.

    config SC_FROST_PROTECTION_TEMP_LOW
        int "Frost protection temperature (lower bound)."
        range -30 100
        default -4
        help
            If the temperature is lower, starts the panel pump.

    config SC_FROST_PROTECTION_TEMP_HIGH
        int "Frost protection temperature (higher bound)."
        range -30 100
        default 1
        help
            If the temperature is higher, stops the panel pump.

    config SC_PANEL_DELTA_TEMP_LOW
        int "Difference of temperature at which the panel pump stops (lower bound)."
        range -30 100
        default 5
        help
            If the temperature is lower, starts the panel pump.

    config SC_PANEL_DELTA_TEMP_HIGH
        int "Difference of temperature at which the panel pump starts (higher bound)."
        range -30 100
        default 10
        help
            If the temperature is higher, stops the panel pump.

    config SC_FLOOR_HEATING_DELTA_TEMP_LOW
        int "Difference of temperature at which the floor heating pump stops (lower bound)."
        range -30 100
        default 5
        help
            If the temperature is lower, starts the panel pump.

    config SC_FLOOR_HEATING_DELTA_TEMP_HIGH
        int "Difference of temperature at which the floor heating pump starts (higher bound)."
        range -30 100
        default 7
        help
            If the temperature is higher, stops the panel pump.

    config MQTT_LWT_TOPIC
        string "MQTT Last Will Testament Topic"
        default "solar-controller/connected"
        help
            Topic where to send LWT (Last Will Testament) upon disconnect.

    config MQTT_COMMAND_TOPIC
        string "MQTT system command Topic"
        default "solar-controller/command"
        help
            Topic where to send system commands.

    config MQTT_SOLAR_VALUE_TOPIC
        string "Where to send measures"
        default "solar-controller/status/solar/%s"
        help
            Topic where to measures.

endmenu
```

## provision/main/Kconfig.projbuild
```kconfig
menu "Provisioning data"

    config ESP_WIFI_SSID
        string "WiFi SSID"
        default ""
        help
            SSID (network name) for the example to connect to.

    config ESP_WIFI_PASSWORD
        string "WiFi Password"
        default ""
        help
            WiFi password (WPA or WPA2) for the example to use.

    config ESP_MAXIMUM_RETRY
        int "Maximum retry"
        default 5
        help
            Set the Maximum retry to avoid station reconnecting to the AP unlimited when the AP is really inexistent.

    config MQTT_URI
        string "MQTT Server URI"
        default "mqtts://server:port"
        help
            MQTT server location.

    config MQTT_USERNAME
        string "MQTT username"
        default ""
        help
            MQTT username.

    config MQTT_PASSWORD
        string "MQTT password"
        default ""
        help
            MQTT password.

    config FIRMWARE_URL_PATTERN
        string "Firmware URL pattern"
        default ""
        help
            Where to download a specific version of the firmware. Complete URL. Must include "%s".

    config PANEL_SENSOR_ADDR
        string "1-wire address of the panel sensor"
        default ""
        help
            1-wire address of the panel sensor.

    config STORE_LOWER_SENSOR_ADDR
        string "1-wire address of the store lower sensor"
        default ""
        help
            1-wire address of the store lower sensor.

    config STORE_HIGHER_SENSOR_ADDR
        string "1-wire address of the store higher sensor"
        default ""
        help
            1-wire address of the store higher sensor.

    config FLOOR_HEATING_SENSOR_ADDR
        string "1-wire address of the floor heating sensor"
        default ""
        help
            1-wire address of the floor heating sensor.
endmenu
```
